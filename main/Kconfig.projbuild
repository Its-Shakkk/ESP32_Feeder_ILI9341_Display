## main/Kconfig.projbuild
```kconfig
menu "Feeder Configuration"

    config FEEDER_WIFI_SSID
        string "WiFi SSID"
        default "People Tech"

    config FEEDER_WIFI_PASSWORD
        string "WiFi password"
        default "PT!Secure#505@432e"

    config FEEDER_NTP_SERVER
        string "NTP server"
        default "pool.ntp.org"

    config FEEDER_TIMEZONE
        string "POSIX timezone string"
        default "IST-5:30"

endmenu
```

## sdkconfig.defaults
```kconfig
CONFIG_IDF_TARGET="esp32"
CONFIG_ESPTOOLPY_FLASHSIZE_4MB=y
CONFIG_PARTITION_TABLE_CUSTOM=y
CONFIG_PARTITION_TABLE_CUSTOM_FILENAME="partitions.csv"
CONFIG_PARTITION_TABLE_FILENAME="partitions.csv"
CONFIG_ESP_DEFAULT_CPU_FREQ_MHZ_240=y
CONFIG_FREERTOS_HZ=1000
CONFIG_ESP_MAIN_TASK_STACK_SIZE=4096
```
